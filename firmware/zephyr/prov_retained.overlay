/* Keep only the final 4 KiB bank for a CRC-protected pre-sleep gravity vector.
 * The rest of CPUAPP SRAM is released in System OFF. No NVS writes. */
/ {
  prov_ram: memory@2003f000 {
    compatible = "zephyr,memory-region", "mmio-sram";
    reg = <0x2003f000 0x1000>;
    zephyr,memory-region = "ProvRetained";
    status = "okay";
    prov_retained: retainedmem {
      compatible = "zephyr,retained-ram";
      status = "okay";
    };
  };
};
&cpuapp_sram {
  reg = <0x20000000 0x3f000>;
  ranges = <0x0 0x20000000 0x3f000>;
};
