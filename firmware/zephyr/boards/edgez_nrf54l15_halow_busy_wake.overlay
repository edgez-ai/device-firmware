#include "edgez_nrf54l15_halow_vbat_off.overlay"

&xiao_spi {
	zephyr,pm-device-runtime-auto;
};

&spi00_sleep {
	/* Preserve inactive SCK/MOSI levels while disconnecting MISO. */
	group1 {
		psels = <NRF_PSEL(SPIM_SCK, 2, 1)>, <NRF_PSEL(SPIM_MOSI, 2, 2)>;
		/delete-property/ low-power-enable;
	};

	group2 {
		psels = <NRF_PSEL(SPIM_MISO, 2, 4)>;
		low-power-enable;
	};
};
